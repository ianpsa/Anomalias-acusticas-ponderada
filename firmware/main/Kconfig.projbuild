## firmware/main/Kconfig.projbuild
```kconfig
menu "Ferris"
config FERRIS_WIFI_SSID
    string "Wi-Fi SSID"
    default ""
config FERRIS_WIFI_PASSWORD
    string "Wi-Fi password"
    default ""
config FERRIS_BRIDGE_URL
    string "Ferris PC wake endpoint (NOT LM Studio)"
    default "http://192.168.1.10:8765/api/device/wake"
config FERRIS_DEVICE_TOKEN
    string "FERRIS_DEVICE_TOKEN from PC"
    default ""
config FERRIS_BCLK
    int "INMP441 SCK GPIO"
    default 26
config FERRIS_WS
    int "INMP441 WS GPIO"
    default 25
config FERRIS_DIN
    int "INMP441 SD GPIO"
    default 22
config FERRIS_LED_RED
    int "Red LED GPIO: muted / capture inactive (with resistor)"
    default 18
config FERRIS_LED_GREEN
    int "Green LED GPIO: listening (with resistor)"
    default 19
config FERRIS_MUTE_BUTTON
    int "Mute toggle button GPIO (button to GND, internal pull-up)"
    default 23
endmenu
```
